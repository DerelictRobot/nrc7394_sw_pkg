## package/src/nrc/Kconfig
```kconfig
config NRC7394_WIFI
	tristate "Newracom 802.11ah Wi-Fi halow driver (NRC7394)"
	depends on MAC80211
	depends on SPI
	---help---
		The Host Driver for Newracom 802.11ah Wi-Fi halow device (NRC7394)
```
